## config/boards/arm/pw9/Kconfig.board
```kconfig
# BT60 board configuration

# Copyright (c) 2021 Polarity Works
# SPDX-License-Identifier: MIT

config BOARD_PW9
	bool "pw9"
	depends on SOC_RP2040
```

## config/boards/arm/pw9/Kconfig.defconfig
```kconfig
# Copyright (c) 2021 Polarity Works
# SPDX-License-Identifier: MIT

if BOARD_PW9

config BOARD
	default "pw9"

if USB

config USB_DEVICE_STACK
	default y

endif # USB

config RP2_FLASH_W25Q080
	default y

config ZMK_USB
	default y


config ZMK_KEYBOARD_NAME
	default "PW9"

endif # BOARD_PW9
```

## config/boards/arm/pw9/pw9_defconfig
```kconfig
# SPDX-License-Identifier: MIT

CONFIG_SOC_SERIES_RP2XXX=y
CONFIG_SOC_RP2040=y
CONFIG_SYS_CLOCK_HW_CYCLES_PER_SEC=125000000
CONFIG_BOARD_PW9=y

# enable GPIO
CONFIG_GPIO=y

# encoder
CONFIG_EC11=y
CONFIG_EC11_TRIGGER_GLOBAL_THREAD=y

CONFIG_SPI=y
CONFIG_WS2812_STRIP=y
CONFIG_ZMK_RGB_UNDERGLOW=y
CONFIG_ZMK_RGB_UNDERGLOW_ON_START=y
CONFIG_ZMK_RGB_UNDERGLOW_HUE_START=262

CONFIG_USE_DT_CODE_PARTITION=y

CONFIG_RESET=y

CONFIG_BUILD_OUTPUT_UF2=y
```
